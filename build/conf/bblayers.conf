## build/conf/bblayers.conf
```bitbake
# POKY_BBLAYERS_CONF_VERSION is increased each time build/conf/bblayers.conf
# changes incompatibly
POKY_BBLAYERS_CONF_VERSION = "2"

BBPATH = "${TOPDIR}"
BBFILES ?= ""

BBLAYERS ?= " \
    /home/kilian/YOCTO-RPI4/poky-dunfell/meta \
    /home/kilian/YOCTO-RPI4/poky-dunfell/meta-poky \
    /home/kilian/YOCTO-RPI4/meta-openembedded/meta-oe \
    /home/kilian/YOCTO-RPI4/meta-openembedded/meta-multimedia \
    /home/kilian/YOCTO-RPI4/meta-openembedded/meta-networking \
    /home/kilian/YOCTO-RPI4/meta-openembedded/meta-perl \
    /home/kilian/YOCTO-RPI4/meta-openembedded/meta-python \
    /home/kilian/YOCTO-RPI4/meta-qt5 \
    /home/kilian/YOCTO-RPI4/meta-raspberrypi \
    /home/kilian/YOCTO-RPI4/meta-security \
    /home/kilian/YOCTO-RPI4/meta-jumpnow \
    /home/kilian/YOCTO-RPI4/rpi64/meta-rpi64 \
"
```
